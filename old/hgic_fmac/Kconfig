## old/utils/Kconfig
```kconfig
config HGIC_USB
	bool "    Support USB interface"
	depends on USB && (HGICS||HGICF)

config HGIC_SDIO
	bool "    Support SDIO interface"
	depends on MMC && (HGICS||HGICF)

config SDIO_REINIT
	bool "    Support Re-init SDIO interface"
	depends on HGIC_SDIO
```

## taixin-fmac-linux-driver-v2.2.1-35256/Kconfig
```kconfig
source "drivers/net/wireless/hugeic/hgic_smac/Kconfig"
source "drivers/net/wireless/hugeic/hgic_fmac/Kconfig"
source "drivers/net/wireless/hugeic/utils/Kconfig"
```
